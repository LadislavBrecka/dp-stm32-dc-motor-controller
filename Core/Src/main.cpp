/* USER CODE BEGIN Header */
/**
  ******************************************************************************
  * @file           : main.c
  * @brief          : Main program body
  ******************************************************************************
  * @attention
  *
  * Copyright (c) 2023 STMicroelectronics.
  * All rights reserved.
  *
  * This software is licensed under terms that can be found in the LICENSE file
  * in the root directory of this software component.
  * If no LICENSE file comes with this software, it is provided AS-IS.
  *
  ******************************************************************************
  */
/* USER CODE END Header */
/* Includes ------------------------------------------------------------------*/
#include "main.h"

/* Private includes ----------------------------------------------------------*/
/* USER CODE BEGIN Includes */
#include<stdio.h>
#include<string.h>

//#include "ident_handler.h"

#include "../ControllingLib/inc/identification.h"
#include "../ControllingLib/inc/pole_placement.h"
#include "../ControllingLib/inc/transfer_fcn.h"

/* USER CODE END Includes */

/* Private typedef -----------------------------------------------------------*/
/* USER CODE BEGIN PTD */

/* USER CODE END PTD */

/* Private define ------------------------------------------------------------*/
/* USER CODE BEGIN PD */
/* USER CODE END PD */

/* Private macro -------------------------------------------------------------*/
/* USER CODE BEGIN PM */
/* USER CODE END PM */

/* Private variables ---------------------------------------------------------*/
ADC_HandleTypeDef hadc1;

TIM_HandleTypeDef htim2;
TIM_HandleTypeDef htim3;
TIM_HandleTypeDef htim4;
TIM_HandleTypeDef htim5;

UART_HandleTypeDef huart2;

/* USER CODE BEGIN PV */

// TRIMMER INPUT VARIABLES
uint16_t 	pot_value = 0;
int16_t 	pwm_stride = 0;

// POSITON CONTROL VARIABLES
uint8_t		actual_direction = FORWARD_DIR;

// HAL SPEED MEASUREMENT VARIABLES
enum HalState 	hal1_state = IDLE;
uint32_t 		hal1_T1 = 0;
uint32_t 		hal1_T2 = 0;
uint16_t 		hal1_ticks = 0;
uint16_t 		hal1_TIM3_OVC = 0;
int32_t 		hal1_freq = 0;
uint16_t		hal1_level = 0;

enum HalState 	hal2_state = IDLE;
uint32_t 		hal2_T1 = 0;
uint32_t 		hal2_T2 = 0;
uint16_t 		hal2_ticks = 0;
uint16_t 		hal2_TIM4_OVC = 0;
int32_t 		hal2_freq = 0;
uint16_t		hal2_level = 0;

// HAL POSITION MEASUREMENT VARIABLES
int32_t 	hal1_abs_pos = 0;
int32_t 	hal1_abs_pos_of = 0;
int32_t 	hal1_abs_pos_prev = 0;

int32_t 	hal2_abs_pos = 0;
int32_t 	hal2_abs_pos_of = 0;
int32_t 	hal2_abs_pos_prev = 0;

// CONTROL SYSTEM VARIABLES
enum AlgorithmStage stage = MANUAL_MODE;

// IDENTIFICATION VARIABLES
uint32_t identification_step = 0;
int16_t		indentification_speed_sp[2048] = {
		  40, 40, 40, 40, 40, 40, 40, 40, 40, 40, 40, 40,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 40,
		  0, 0, 0, 0, 0, 0, 0, 0, 0, 0, 0, 0,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 0,
		  30, 30, 30, 30, 30, 30, 30, 30, 30, 30, 30, 30,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 30,
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		  0, 0, 0, 0, 0, 0, 0, 0, 0, 0, 0, 0,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 0,
		 //		 -99, -99, -99, -99, -99, -99, -99, -99, -99, -99, -99, -99, -99,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 -99,
//		  30, 30, 30, 30, 30, 30, 30, 30, 30, 30, 30, 30, 30,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 30
//		  70, 70, 70, 70, 70, 70, 70, 70, 70, 70, 70, 70, 70,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 70,
};

DT::Identificator* identificator = nullptr;
double thetas[2] = { 0, 0 };
double reg_coefs[3] = { 0, 0, 0 };

// CLOSED LOOP VARIABLES
uint32_t closed_loop_step = 0;
int16_t		closed_loop_pos_sp[2048] = {
		400, 400, 400, 400, 400, 400, 400, 400, 400, 400, 400, 400,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 400,
		400, 400, 400, 400, 400, 400, 400, 400, 400, 400, 400, 400,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 400,
		400, 400, 400, 400, 400, 400, 400, 400, 400, 400, 400, 400,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 400,
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	  -300, -300, -300, -300, -300, -300, -300, -300, -300, -300, -300, -300,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 -300,
		 //		 -99, -99, -99, -99, -99, -99, -99, -99, -99, -99, -99, -99, -99,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 -99,
//		  30, 30, 30, 30, 30, 30, 30, 30, 30, 30, 30, 30, 30,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 30
//		  70, 70, 70, 70, 70, 70, 70, 70, 70, 70, 70, 70, 70,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 70,
};

DT::PIVRegulator* reg = nullptr;

/* USER CODE END PV */

/* Private function prototypes -----------------------------------------------*/
void SystemClock_Config(void);
static void MX_GPIO_Init(void);
static void MX_TIM2_Init(void);
static void MX_ADC1_Init(void);
static void MX_TIM3_Init(void);
static void MX_USART2_UART_Init(void);
static void MX_TIM4_Init(void);
static void MX_TIM5_Init(void);
/* USER CODE BEGIN PFP */

void update_abs_position();
void phase_to_direction();
void send_data_usart(int16_t, int32_t);
void check_zero_speed();
SimData automatic_system_loop();
void set_motor_direction(int32_t);
uint32_t get_absolute_value(int32_t);
void compute_hal_freq(int32_t*, uint16_t*, HalState*, uint16_t*, TIM_TypeDef*, int32_t*,
					  uint32_t*, uint32_t*, uint16_t*, GPIO_TypeDef*, uint16_t);

/* USER CODE END PFP */

/* Private user code ---------------------------------------------------------*/
/* USER CODE BEGIN 0 */

/* USER CODE END 0 */

/**
  * @brief  The application entry point.
  * @retval int
  */
int main(void)
{
  /* USER CODE BEGIN 1 */

  /* USER CODE END 1 */

  /* MCU Configuration--------------------------------------------------------*/

  /* Reset of all peripherals, Initializes the Flash interface and the Systick. */
  HAL_Init();

  /* USER CODE BEGIN Init */

  /* USER CODE END Init */

  /* Configure the system clock */
  SystemClock_Config();

  /* USER CODE BEGIN SysInit */

  /* USER CODE END SysInit */

  /* Initialize all configured peripherals */
  MX_GPIO_Init();
  MX_TIM2_Init();
  MX_ADC1_Init();
  MX_TIM3_Init();
  MX_USART2_UART_Init();
  MX_TIM4_Init();
  MX_TIM5_Init();
  /* USER CODE BEGIN 2 */

  // STARTING ALL PERIPHERALS
  HAL_TIM_Base_Start_IT(&htim2);	// timer for generating PWM signal
  HAL_TIM_PWM_Start(&htim2, TIM_CHANNEL_2);

  HAL_ADC_Start_IT(&hadc1);  		// ADC for scanning trimmer set value

  HAL_TIM_Base_Start_IT(&htim3);  	// timer for measuring HAL 1 frequency
  HAL_TIM_IC_Start_IT(&htim3, TIM_CHANNEL_1);

  HAL_TIM_Base_Start_IT(&htim4);   	// timer for measuring HAL 2 frequency
  HAL_TIM_IC_Start_IT(&htim4, TIM_CHANNEL_1);

  HAL_TIM_Base_Start_IT(&htim5); 	// timer for send data over USART

  /* USER CODE END 2 */

  /* Infinite loop */
  /* USER CODE BEGIN WHILE */

  // SETTING INITIAL STATE
  TIM2->CCR2 = (htim2.Init.Period * 0) / 100u; // setting up initial PWM stride to 0%

  while (1) {
    /* USER CODE END WHILE */

    /* USER CODE BEGIN 3 */
	HAL_ADC_Start_IT(&hadc1);

  }
  /* USER CODE END 3 */
}

/**
  * @brief System Clock Configuration
  * @retval None
  */
void SystemClock_Config(void)
{
  RCC_OscInitTypeDef RCC_OscInitStruct = {0};
  RCC_ClkInitTypeDef RCC_ClkInitStruct = {0};

  /** Configure the main internal regulator output voltage
  */
  __HAL_RCC_PWR_CLK_ENABLE();
  __HAL_PWR_VOLTAGESCALING_CONFIG(PWR_REGULATOR_VOLTAGE_SCALE3);

  /** Initializes the RCC Oscillators according to the specified parameters
  * in the RCC_OscInitTypeDef structure.
  */
  RCC_OscInitStruct.OscillatorType = RCC_OSCILLATORTYPE_HSI;
  RCC_OscInitStruct.HSIState = RCC_HSI_ON;
  RCC_OscInitStruct.HSICalibrationValue = RCC_HSICALIBRATION_DEFAULT;
  RCC_OscInitStruct.PLL.PLLState = RCC_PLL_NONE;
  if (HAL_RCC_OscConfig(&RCC_OscInitStruct) != HAL_OK)
  {
    Error_Handler();
  }

  /** Initializes the CPU, AHB and APB buses clocks
  */
  RCC_ClkInitStruct.ClockType = RCC_CLOCKTYPE_HCLK|RCC_CLOCKTYPE_SYSCLK
                              |RCC_CLOCKTYPE_PCLK1|RCC_CLOCKTYPE_PCLK2;
  RCC_ClkInitStruct.SYSCLKSource = RCC_SYSCLKSOURCE_HSI;
  RCC_ClkInitStruct.AHBCLKDivider = RCC_SYSCLK_DIV1;
  RCC_ClkInitStruct.APB1CLKDivider = RCC_HCLK_DIV2;
  RCC_ClkInitStruct.APB2CLKDivider = RCC_HCLK_DIV1;

  if (HAL_RCC_ClockConfig(&RCC_ClkInitStruct, FLASH_LATENCY_0) != HAL_OK)
  {
    Error_Handler();
  }
}

/**
  * @brief ADC1 Initialization Function
  * @param None
  * @retval None
  */
static void MX_ADC1_Init(void)
{

  /* USER CODE BEGIN ADC1_Init 0 */

  /* USER CODE END ADC1_Init 0 */

  ADC_ChannelConfTypeDef sConfig = {0};

  /* USER CODE BEGIN ADC1_Init 1 */

  /* USER CODE END ADC1_Init 1 */

  /** Configure the global features of the ADC (Clock, Resolution, Data Alignment and number of conversion)
  */
  hadc1.Instance = ADC1;
  hadc1.Init.ClockPrescaler = ADC_CLOCK_SYNC_PCLK_DIV4;
  hadc1.Init.Resolution = ADC_RESOLUTION_12B;
  hadc1.Init.ScanConvMode = DISABLE;
  hadc1.Init.ContinuousConvMode = DISABLE;
  hadc1.Init.DiscontinuousConvMode = DISABLE;
  hadc1.Init.ExternalTrigConvEdge = ADC_EXTERNALTRIGCONVEDGE_NONE;
  hadc1.Init.ExternalTrigConv = ADC_SOFTWARE_START;
  hadc1.Init.DataAlign = ADC_DATAALIGN_RIGHT;
  hadc1.Init.NbrOfConversion = 1;
  hadc1.Init.DMAContinuousRequests = DISABLE;
  hadc1.Init.EOCSelection = ADC_EOC_SINGLE_CONV;
  if (HAL_ADC_Init(&hadc1) != HAL_OK)
  {
    Error_Handler();
  }

  /** Configure for the selected ADC regular channel its corresponding rank in the sequencer and its sample time.
  */
  sConfig.Channel = ADC_CHANNEL_7;
  sConfig.Rank = 1;
  sConfig.SamplingTime = ADC_SAMPLETIME_3CYCLES;
  if (HAL_ADC_ConfigChannel(&hadc1, &sConfig) != HAL_OK)
  {
    Error_Handler();
  }
  /* USER CODE BEGIN ADC1_Init 2 */

  /* USER CODE END ADC1_Init 2 */

}

/**
  * @brief TIM2 Initialization Function
  * @param None
  * @retval None
  */
static void MX_TIM2_Init(void)
{

  /* USER CODE BEGIN TIM2_Init 0 */

  /* USER CODE END TIM2_Init 0 */

  TIM_ClockConfigTypeDef sClockSourceConfig = {0};
  TIM_MasterConfigTypeDef sMasterConfig = {0};
  TIM_OC_InitTypeDef sConfigOC = {0};

  /* USER CODE BEGIN TIM2_Init 1 */

  /* USER CODE END TIM2_Init 1 */
  htim2.Instance = TIM2;
  htim2.Init.Prescaler = 160;
  htim2.Init.CounterMode = TIM_COUNTERMODE_UP;
  htim2.Init.Period = 100;
  htim2.Init.ClockDivision = TIM_CLOCKDIVISION_DIV1;
  htim2.Init.AutoReloadPreload = TIM_AUTORELOAD_PRELOAD_DISABLE;
  if (HAL_TIM_Base_Init(&htim2) != HAL_OK)
  {
    Error_Handler();
  }
  sClockSourceConfig.ClockSource = TIM_CLOCKSOURCE_INTERNAL;
  if (HAL_TIM_ConfigClockSource(&htim2, &sClockSourceConfig) != HAL_OK)
  {
    Error_Handler();
  }
  if (HAL_TIM_PWM_Init(&htim2) != HAL_OK)
  {
    Error_Handler();
  }
  sMasterConfig.MasterOutputTrigger = TIM_TRGO_RESET;
  sMasterConfig.MasterSlaveMode = TIM_MASTERSLAVEMODE_DISABLE;
  if (HAL_TIMEx_MasterConfigSynchronization(&htim2, &sMasterConfig) != HAL_OK)
  {
    Error_Handler();
  }
  sConfigOC.OCMode = TIM_OCMODE_PWM1;
  sConfigOC.Pulse = 50;
  sConfigOC.OCPolarity = TIM_OCPOLARITY_HIGH;
  sConfigOC.OCFastMode = TIM_OCFAST_ENABLE;
  if (HAL_TIM_PWM_ConfigChannel(&htim2, &sConfigOC, TIM_CHANNEL_2) != HAL_OK)
  {
    Error_Handler();
  }
  /* USER CODE BEGIN TIM2_Init 2 */

  /* USER CODE END TIM2_Init 2 */
  HAL_TIM_MspPostInit(&htim2);

}

/**
  * @brief TIM3 Initialization Function
  * @param None
  * @retval None
  */
static void MX_TIM3_Init(void)
{

  /* USER CODE BEGIN TIM3_Init 0 */

  /* USER CODE END TIM3_Init 0 */

  TIM_ClockConfigTypeDef sClockSourceConfig = {0};
  TIM_MasterConfigTypeDef sMasterConfig = {0};
  TIM_IC_InitTypeDef sConfigIC = {0};

  /* USER CODE BEGIN TIM3_Init 1 */

  /* USER CODE END TIM3_Init 1 */
  htim3.Instance = TIM3;
  htim3.Init.Prescaler = 160;
  htim3.Init.CounterMode = TIM_COUNTERMODE_UP;
  htim3.Init.Period = 65535;
  htim3.Init.ClockDivision = TIM_CLOCKDIVISION_DIV1;
  htim3.Init.AutoReloadPreload = TIM_AUTORELOAD_PRELOAD_ENABLE;
  if (HAL_TIM_Base_Init(&htim3) != HAL_OK)
  {
    Error_Handler();
  }
  sClockSourceConfig.ClockSource = TIM_CLOCKSOURCE_INTERNAL;
  if (HAL_TIM_ConfigClockSource(&htim3, &sClockSourceConfig) != HAL_OK)
  {
    Error_Handler();
  }
  if (HAL_TIM_IC_Init(&htim3) != HAL_OK)
  {
    Error_Handler();
  }
  sMasterConfig.MasterOutputTrigger = TIM_TRGO_RESET;
  sMasterConfig.MasterSlaveMode = TIM_MASTERSLAVEMODE_DISABLE;
  if (HAL_TIMEx_MasterConfigSynchronization(&htim3, &sMasterConfig) != HAL_OK)
  {
    Error_Handler();
  }
  sConfigIC.ICPolarity = TIM_INPUTCHANNELPOLARITY_BOTHEDGE;
  sConfigIC.ICSelection = TIM_ICSELECTION_DIRECTTI;
  sConfigIC.ICPrescaler = TIM_ICPSC_DIV1;
  sConfigIC.ICFilter = 0;
  if (HAL_TIM_IC_ConfigChannel(&htim3, &sConfigIC, TIM_CHANNEL_1) != HAL_OK)
  {
    Error_Handler();
  }
  /* USER CODE BEGIN TIM3_Init 2 */

  /* USER CODE END TIM3_Init 2 */

}

/**
  * @brief TIM4 Initialization Function
  * @param None
  * @retval None
  */
static void MX_TIM4_Init(void)
{

  /* USER CODE BEGIN TIM4_Init 0 */

  /* USER CODE END TIM4_Init 0 */

  TIM_ClockConfigTypeDef sClockSourceConfig = {0};
  TIM_MasterConfigTypeDef sMasterConfig = {0};
  TIM_IC_InitTypeDef sConfigIC = {0};

  /* USER CODE BEGIN TIM4_Init 1 */

  /* USER CODE END TIM4_Init 1 */
  htim4.Instance = TIM4;
  htim4.Init.Prescaler = 160;
  htim4.Init.CounterMode = TIM_COUNTERMODE_UP;
  htim4.Init.Period = 65535;
  htim4.Init.ClockDivision = TIM_CLOCKDIVISION_DIV1;
  htim4.Init.AutoReloadPreload = TIM_AUTORELOAD_PRELOAD_ENABLE;
  if (HAL_TIM_Base_Init(&htim4) != HAL_OK)
  {
    Error_Handler();
  }
  sClockSourceConfig.ClockSource = TIM_CLOCKSOURCE_INTERNAL;
  if (HAL_TIM_ConfigClockSource(&htim4, &sClockSourceConfig) != HAL_OK)
  {
    Error_Handler();
  }
  if (HAL_TIM_IC_Init(&htim4) != HAL_OK)
  {
    Error_Handler();
  }
  sMasterConfig.MasterOutputTrigger = TIM_TRGO_RESET;
  sMasterConfig.MasterSlaveMode = TIM_MASTERSLAVEMODE_DISABLE;
  if (HAL_TIMEx_MasterConfigSynchronization(&htim4, &sMasterConfig) != HAL_OK)
  {
    Error_Handler();
  }
  sConfigIC.ICPolarity = TIM_INPUTCHANNELPOLARITY_BOTHEDGE;
  sConfigIC.ICSelection = TIM_ICSELECTION_DIRECTTI;
  sConfigIC.ICPrescaler = TIM_ICPSC_DIV1;
  sConfigIC.ICFilter = 4;
  if (HAL_TIM_IC_ConfigChannel(&htim4, &sConfigIC, TIM_CHANNEL_1) != HAL_OK)
  {
    Error_Handler();
  }
  /* USER CODE BEGIN TIM4_Init 2 */

  /* USER CODE END TIM4_Init 2 */

}

/**
  * @brief TIM5 Initialization Function
  * @param None
  * @retval None
  */
static void MX_TIM5_Init(void)
{

  /* USER CODE BEGIN TIM5_Init 0 */

  /* USER CODE END TIM5_Init 0 */

  TIM_ClockConfigTypeDef sClockSourceConfig = {0};
  TIM_MasterConfigTypeDef sMasterConfig = {0};

  /* USER CODE BEGIN TIM5_Init 1 */

  /* USER CODE END TIM5_Init 1 */
  htim5.Instance = TIM5;
  htim5.Init.Prescaler = 160;
  htim5.Init.CounterMode = TIM_COUNTERMODE_UP;
  htim5.Init.Period = 1000;
  htim5.Init.ClockDivision = TIM_CLOCKDIVISION_DIV1;
  htim5.Init.AutoReloadPreload = TIM_AUTORELOAD_PRELOAD_ENABLE;
  if (HAL_TIM_Base_Init(&htim5) != HAL_OK)
  {
    Error_Handler();
  }
  sClockSourceConfig.ClockSource = TIM_CLOCKSOURCE_INTERNAL;
  if (HAL_TIM_ConfigClockSource(&htim5, &sClockSourceConfig) != HAL_OK)
  {
    Error_Handler();
  }
  sMasterConfig.MasterOutputTrigger = TIM_TRGO_RESET;
  sMasterConfig.MasterSlaveMode = TIM_MASTERSLAVEMODE_DISABLE;
  if (HAL_TIMEx_MasterConfigSynchronization(&htim5, &sMasterConfig) != HAL_OK)
  {
    Error_Handler();
  }
  /* USER CODE BEGIN TIM5_Init 2 */

  /* USER CODE END TIM5_Init 2 */

}

/**
  * @brief USART2 Initialization Function
  * @param None
  * @retval None
  */
static void MX_USART2_UART_Init(void)
{

  /* USER CODE BEGIN USART2_Init 0 */

  /* USER CODE END USART2_Init 0 */

  /* USER CODE BEGIN USART2_Init 1 */

  /* USER CODE END USART2_Init 1 */
  huart2.Instance = USART2;
  huart2.Init.BaudRate = 115200;
  huart2.Init.WordLength = UART_WORDLENGTH_8B;
  huart2.Init.StopBits = UART_STOPBITS_1;
  huart2.Init.Parity = UART_PARITY_NONE;
  huart2.Init.Mode = UART_MODE_TX_RX;
  huart2.Init.HwFlowCtl = UART_HWCONTROL_NONE;
  huart2.Init.OverSampling = UART_OVERSAMPLING_16;
  if (HAL_UART_Init(&huart2) != HAL_OK)
  {
    Error_Handler();
  }
  /* USER CODE BEGIN USART2_Init 2 */

  /* USER CODE END USART2_Init 2 */

}

/**
  * @brief GPIO Initialization Function
  * @param None
  * @retval None
  */
static void MX_GPIO_Init(void)
{
  GPIO_InitTypeDef GPIO_InitStruct = {0};

  /* GPIO Ports Clock Enable */
  __HAL_RCC_GPIOH_CLK_ENABLE();
  __HAL_RCC_GPIOA_CLK_ENABLE();
  __HAL_RCC_GPIOB_CLK_ENABLE();

  /*Configure GPIO pin Output Level */
  HAL_GPIO_WritePin(GPIOB, MOTOR_DIRECTION_1_Pin|MOTOR_DIRECTION_2_Pin, GPIO_PIN_RESET);

  /*Configure GPIO pin : RESET_CLOSED_LOOP_BUTTON_Pin */
  GPIO_InitStruct.Pin = RESET_CLOSED_LOOP_BUTTON_Pin;
  GPIO_InitStruct.Mode = GPIO_MODE_IT_RISING;
  GPIO_InitStruct.Pull = GPIO_NOPULL;
  HAL_GPIO_Init(RESET_CLOSED_LOOP_BUTTON_GPIO_Port, &GPIO_InitStruct);

  /*Configure GPIO pin : RESET_EXPERIMENT_BUTTON_Pin */
  GPIO_InitStruct.Pin = RESET_EXPERIMENT_BUTTON_Pin;
  GPIO_InitStruct.Mode = GPIO_MODE_IT_FALLING;
  GPIO_InitStruct.Pull = GPIO_NOPULL;
  HAL_GPIO_Init(RESET_EXPERIMENT_BUTTON_GPIO_Port, &GPIO_InitStruct);

  /*Configure GPIO pins : MOTOR_DIRECTION_1_Pin MOTOR_DIRECTION_2_Pin */
  GPIO_InitStruct.Pin = MOTOR_DIRECTION_1_Pin|MOTOR_DIRECTION_2_Pin;
  GPIO_InitStruct.Mode = GPIO_MODE_OUTPUT_PP;
  GPIO_InitStruct.Pull = GPIO_NOPULL;
  GPIO_InitStruct.Speed = GPIO_SPEED_FREQ_LOW;
  HAL_GPIO_Init(GPIOB, &GPIO_InitStruct);

  /* EXTI interrupt init*/
  HAL_NVIC_SetPriority(EXTI9_5_IRQn, 2, 0);
  HAL_NVIC_EnableIRQ(EXTI9_5_IRQn);

  HAL_NVIC_SetPriority(EXTI15_10_IRQn, 0, 0);
  HAL_NVIC_EnableIRQ(EXTI15_10_IRQn);

}

/* USER CODE BEGIN 4 */

// TIMER GLOBAL INTERRUPT HANDLER FOR ALL TIMERS
void HAL_TIM_PeriodElapsedCallback(TIM_HandleTypeDef* htim)
{
	// TIM2 is used for PWM signal generation
	if (htim->Instance == TIM2)
	{
		// pwm_stride needs to be in abs value as it can be in interval <-100, 100> (both directions)
		set_motor_direction(pwm_stride);
		TIM2->CCR2 = (htim2.Init.Period * get_absolute_value(pwm_stride)) / 100u;
	}

	// TIM3 is used for measuring frequency of the rotation of DC Motor from HAL 1 Sensor
	else if (htim->Instance == TIM3)
	{
		// if timer overflow, increment overflow flag
		hal1_TIM3_OVC++;
	}

	// TIM4 is used for measuring frequency of the rotation of DC Motor from HAL 1 Sensor
	else if (htim->Instance == TIM4)
	{
		// if timer overflow, increment overflow flag
		hal2_TIM4_OVC++;
	}

	// TIM5 is used for system loop - frequency is in hard real time - 0,01s
	else if (htim->Instance == TIM5)
	{
		// handler for USART data transfer to PC
		if (stage == MANUAL_MODE)
		{
			send_data_usart(pwm_stride, hal1_freq);
		}
		else
		{
			SimData data = automatic_system_loop();
			send_data_usart(data.u_speed, data.y_speed);
		}

		// if rpm is zero, than HAL speed will be set to last non-zero number
		// this function handles it
		check_zero_speed();
	}
}

// TIMER CAPTURE INTERRUPT FOR ANALYZING HAL SENSOR SIGNALS
void HAL_TIM_IC_CaptureCallback(TIM_HandleTypeDef* htim)
{
	// if there is falling or rising edge on TIM3 (which is analyzing signal from HAL 1), do frequency computation for HAL 1
	if (htim->Instance == TIM3)
	{
		compute_hal_freq(&hal1_freq, &hal1_ticks, &hal1_state, &hal1_level,
							TIM3, &hal1_abs_pos, &hal1_T1, &hal1_T2, &hal1_TIM3_OVC, GPIOA, GPIO_PIN_6);
	}

	// if there is falling or rising edge on TIM4 (which is analyzing signal from HAL 2), do frequency computation for HAL 2
	else if (htim->Instance == TIM4)
	{
		compute_hal_freq(&hal2_freq, &hal2_ticks, &hal2_state, &hal2_level,
							TIM4, &hal2_abs_pos, &hal2_T1, &hal2_T2, &hal2_TIM4_OVC, GPIOB, GPIO_PIN_6);
	}
}

void HAL_ADC_ConvCpltCallback(ADC_HandleTypeDef* hadc)
{
	// scan input trimmer only in MANUAL MODE, otherwise do logic in automatic_system_loop()
	if (stage == MANUAL_MODE)
	{
		pot_value = HAL_ADC_GetValue(&hadc1);
		pwm_stride = ( ( (PWM_MAX - PWM_MIN) * (pot_value - POT_MIN) ) / (POT_MAX - POT_MIN)) + PWM_MIN;
		if (pwm_stride > PWM_MAX) pwm_stride = PWM_MAX;
		if (pwm_stride < PWM_MIN) pwm_stride = PWM_MIN;
	}
}

void HAL_GPIO_EXTI_Callback(uint16_t GPIO_Pin)
{
  if(GPIO_Pin == RESET_EXPERIMENT_BUTTON_Pin)
  {
	  identificator = new DT::Identificator(DT::LSM, 1, 1);
	  stage = NON_IDENTIFIED;
	  identification_step = 0;
  }
  else if(GPIO_Pin == RESET_CLOSED_LOOP_BUTTON_Pin)
  {
	  reg = new DT::PIVRegulator(DT::TPZ, reg_coefs[0], reg_coefs[1], reg_coefs[2], 0.01, -100.0, 100.0, 1.0);
	  stage = READY_FOR_REGULATION;
	  closed_loop_step = 0;
  }
  else
  {
      __NOP();
  }
}

SimData automatic_system_loop()
{
	int16_t u_speed = 0;
	int32_t y_speed = hal1_freq;
	int32_t y_pos = hal1_abs_pos;

	// IDENTIFICATION EXPERIMENT
	if (stage == NON_IDENTIFIED)
	{
		if (identification_step < (sizeof(indentification_speed_sp) / sizeof(* indentification_speed_sp)))
		{
			u_speed = indentification_speed_sp[identification_step++];
			pwm_stride = u_speed;
			// identification
			identificator->update_coeficients((double) u_speed, (double) y_speed);
		}
		else
		{
			Eigen::VectorXd vx = identificator->get_thetas();
			thetas[0] = vx[0]; thetas[1] = vx[1];
			delete identificator;
			identificator = nullptr;
			stage = IDENTIFIED;
			u_speed = pwm_stride;
		}
	}

	// PPM REGULATOR SETTING
	else if (stage == IDENTIFIED)
	{
        Eigen::VectorXd A{{1, thetas[0]}};
        Eigen::VectorXd B{{thetas[1]}};
        DT::TransferFunction dc_model(B, A);
        DT::TransferFunction c_model;
        dc_model.d2c(0.01, c_model);
		DT::PIVRegCoefs coefs = DT::PolePlacement::PIV_0z_1p(c_model, DT::TPZ, 2.0, 0.7, 1.0);
		reg_coefs[0] = coefs.P; reg_coefs[1] = coefs.I; reg_coefs[2] = coefs.V;
		stage = MANUAL_MODE;
	}

	// REGULATION SHOWCASE
	else if (stage == READY_FOR_REGULATION)
	{
		if (closed_loop_step < (sizeof(closed_loop_pos_sp) / sizeof(* closed_loop_pos_sp)))
		{
			int32_t w_pos = closed_loop_pos_sp[closed_loop_step++];
			pwm_stride = reg->step(w_pos, y_speed, y_pos);
		}
		else
		{
			delete reg;
			reg = nullptr;
			stage = MANUAL_MODE;
			u_speed = pwm_stride;
		}
	}

	return { u_speed, y_speed };
}

void compute_hal_freq(int32_t* hal_freq, uint16_t* hal_ticks, HalState* hal_state, uint16_t* hal_level,
		TIM_TypeDef* tim, int32_t* hal_abs_pos, uint32_t* T1, uint32_t *T2, uint16_t* TIM_OVC, GPIO_TypeDef* port, uint16_t pin)
{
	// initial rising edge detection
	if (*hal_state == IDLE && HAL_GPIO_ReadPin(port, pin))
	{
		*T1 = tim->CCR1;
		*TIM_OVC = 0;
		*hal_state = RUNNING;
	}

	// all others rising edge detections
	else if (*hal_state == RUNNING && HAL_GPIO_ReadPin(port, pin))
	{
		*hal_level = 1;
		*T2 = tim->CCR1;
		*hal_ticks = (*T2 + (*TIM_OVC * 65536)) - *T1;
		*hal_freq = (uint32_t)(F_CLK/ (*hal_ticks));
		*T1 = tim->CCR1;
		*TIM_OVC = 0;

		// check for phase offset - only for HAL 1 sensor as there is a lot of noise
		if (hal_level == &hal1_level)
		{
			phase_to_direction();
		}

		actual_direction == FORWARD_DIR ? (*hal_abs_pos)++ : (*hal_abs_pos)--;

		// scale HAL frequency to <-100, 100>
		if (actual_direction == BACKWARD_DIR)
		{
			*hal_freq = - (*hal_freq);
		}
	}

	// all others falling edge detections
	else if (*hal_state == RUNNING && !HAL_GPIO_ReadPin(port, pin))
	{
		*hal_level = 0;
	}
}

void set_motor_direction(int32_t stride)
{
	HAL_GPIO_WritePin(MOTOR_DIRECTION_1_GPIO_Port, MOTOR_DIRECTION_1_Pin, stride >= 0 ? GPIO_PIN_SET : GPIO_PIN_RESET);
	HAL_GPIO_WritePin(MOTOR_DIRECTION_2_GPIO_Port, MOTOR_DIRECTION_2_Pin, stride < 0  ? GPIO_PIN_SET : GPIO_PIN_RESET);
}

void phase_to_direction()
{
	// set direction based on phase offset
	if (hal1_level != hal2_level) 	actual_direction = FORWARD_DIR;
	else							actual_direction = BACKWARD_DIR;
}

void update_abs_position()
{
	// based on direction, increment or decrement absolute position
	actual_direction == FORWARD_DIR ? hal1_abs_pos++ : hal1_abs_pos--;
	actual_direction == FORWARD_DIR ? hal2_abs_pos++ : hal2_abs_pos--;
}

void check_zero_speed()
{
	// if there is derivative of 0 for absolute position by HAL 1 sensor,
	// force both HAL signals frequency to 0 - it cannot be set by computation
	if (hal1_abs_pos_prev == hal1_abs_pos)
	{
		hal1_freq = 0; hal2_freq = 0;
	}

	hal1_abs_pos_prev = hal1_abs_pos;
	hal2_abs_pos_prev = hal2_abs_pos;
}

void send_data_usart(int16_t u_speed, int32_t y_speed)
{
	USART_Data data = { u_speed, y_speed, hal1_abs_pos };
	char buffer[sizeof(data)];
	memcpy(buffer, &data, sizeof(data));
	HAL_UART_Transmit(&huart2, (uint8_t*)"S", sizeof("S"), 100);
	HAL_UART_Transmit(&huart2, (uint8_t *)buffer, sizeof(data), 100);
	HAL_UART_Transmit(&huart2, (uint8_t*)"Z", sizeof("Z"), 100);
}

uint32_t get_absolute_value(int32_t value)
{
	uint32_t temp = value >> 31;     // make a mask of the sign bit
	value ^= temp;                   // toggle the bits if value is negative
	value += temp & 1;               // add one if value was negative
	return value;
}

/* USER CODE END 4 */

/**
  * @brief  This function is executed in case of error occurrence.
  * @retval None
  */
void Error_Handler(void)
{
  /* USER CODE BEGIN Error_Handler_Debug */
  /* User can add his own implementation to report the HAL error return state */
  __disable_irq();
  while (1)
  {
  }
  /* USER CODE END Error_Handler_Debug */
}

#ifdef  USE_FULL_ASSERT
/**
  * @brief  Reports the name of the source file and the source line number
  *         where the assert_param error has occurred.
  * @param  file: pointer to the source file name
  * @param  line: assert_param error line source number
  * @retval None
  */
void assert_failed(uint8_t *file, uint32_t line)
{
  /* USER CODE BEGIN 6 */
  /* User can add his own implementation to report the file name and line number,
     ex: printf("Wrong parameters value: file %s on line %d\r\n", file, line) */
  /* USER CODE END 6 */
}
#endif /* USE_FULL_ASSERT */
